#include "sd_logger.h"
#include "../config.h"
#include "../config/settings.h"
#include <SD.h>
#include <ArduinoJson.h>

// ================= ZMIENNE GLOBALNE =================
bool sdInitialized = false;
unsigned long totalLoggedEvents = 0;
String lastLogError = "";

// ================= IMPLEMENTACJE =================

/**
 * Inicjalizacja karty SD i systemu logowania dla Pico2
 */
void initializeSDLogger() {
    Serial.println("[SD-LOGGER-INIT] Inicjalizacja karty SD dla Pico2");
    Serial.printf("[SD-LOGGER-CONFIG] CS Pin: GP%d, MOSI: GP%d, MISO: GP%d, CLK: GP%d\n", 
                  SD_CS_PIN, SD_MOSI_PIN, SD_MISO_PIN, SD_CLK_PIN);
    
    // Konfiguruj SPI pins dla Pico2
    SPI.setRX(SD_MISO_PIN);
    SPI.setTX(SD_MOSI_PIN);
    SPI.setSCK(SD_CLK_PIN);
    
    // Inicjalizuj SD kartę
    if (!SD.begin(SD_CS_PIN)) {
        Serial.println("[SD-LOGGER-ERROR] Nie można zainicjalizować karty SD!");
        Serial.println("[SD-LOGGER-ERROR] Sprawdź kartę SD i połączenia SPI");
        sdInitialized = false;
        lastLogError = "SD initialization failed";
        return;
    }
    
    sdInitialized = true;
    Serial.println("[SD-LOGGER-SUCCESS] Karta SD zainicjalizowana pomyślnie");
    
    // Sprawdź czy plik logów już istnieje
    if (SD.exists(LOG_FILE_PATH)) {
        // Policz istniejące zdarzenia
        totalLoggedEvents = countExistingEvents();
        Serial.printf("[SD-LOGGER-EXISTING] Znaleziono plik logów z %lu zdarzeniami\n", totalLoggedEvents);
    } else {
        // Utwórz nowy plik logów
        createNewLogFile();
        totalLoggedEvents = 0;
        Serial.println("[SD-LOGGER-NEW] Utworzono nowy plik logów");
    }
    
    // Wyświetl informacje o karcie SD
    displaySDInfo();
    Serial.println();
}

/**
 * Zapisz zdarzenie pompowania do loga
 */
bool logPumpEvent(const String& type, int volumeML, const String& timestamp) {
    if (!sdInitialized) {
        lastLogError = "SD not initialized";
        Serial.println("[SD-LOGGER-ERROR] SD nie zainicjalizowana - nie można zapisać");
        return false;
    }
    
    // Pobierz następne ID zdarzenia
    unsigned long eventId = getNextEventId();
    
    Serial.printf("[SD-LOGGER-EVENT] Zapisywanie zdarzenia ID:%lu, Type:%s, Volume:%dml\n", 
                  eventId, type.c_str(), volumeML);
    
    // Utwórz obiekt JSON zdarzenia
    JsonDocument eventDoc;
    eventDoc["id"] = eventId;
    eventDoc["timestamp"] = timestamp;
    eventDoc["type"] = type;
    eventDoc["volume_ml"] = volumeML;
    eventDoc["pump_result"] = "";  // Na przyszłość - potwierdzenie ze sprzętu
    
    // Konwertuj na string
    String eventJson;
    serializeJson(eventDoc, eventJson);
    
    // Zapisz do pliku
    bool success = appendEventToFile(eventJson);
    
    if (success) {
        totalLoggedEvents++;
        incrementEventId();  // Zwiększ ID w EEPROM
        
        Serial.printf("[SD-LOGGER-SUCCESS] Zdarzenie zapisane pomyślnie (łącznie: %lu)\n", totalLoggedEvents);
        
        #if ENABLE_DEBUG_LOGS
        Serial.println("[SD-LOGGER-JSON] " + eventJson);
        #endif
        
        return true;
    } else {
        Serial.println("[SD-LOGGER-ERROR] Błąd zapisu zdarzenia na SD");
        return false;
    }
}

/**
 * Dołącz zdarzenie do pliku logów
 */
bool appendEventToFile(const String& eventJson) {
    File logFile = SD.open(LOG_FILE_PATH, FILE_WRITE);
    
    if (!logFile) {
        lastLogError = "Cannot open log file for writing";
        Serial.printf("[SD-LOGGER-ERROR] Nie można otworzyć pliku %s do zapisu\n", LOG_FILE_PATH);
        return false;
    }
    
    // Zapisz zdarzenie (każde w nowej linii dla łatwości parsowania)
    logFile.println(eventJson);
    logFile.close();
    
    return true;
}

/**
 * Utwórz nowy plik logów
 */
bool createNewLogFile() {
    File logFile = SD.open(LOG_FILE_PATH, FILE_WRITE);
    
    if (!logFile) {
        lastLogError = "Cannot create new log file";
        Serial.printf("[SD-LOGGER-ERROR] Nie można utworzyć nowego pliku %s\n", LOG_FILE_PATH);
        return false;
    }
    
    // Utwórz nagłówek pliku (opcjonalnie)
    logFile.println("# Water Addition Events Log");
    logFile.println("# Format: JSON per line");
    logFile.println("# Generated by Pico2 Water System v" VERSION);
    logFile.println();
    
    logFile.close();
    return true;
}

/**
 * Policz istniejące zdarzenia w pliku
 */
unsigned long countExistingEvents() {
    File logFile = SD.open(LOG_FILE_PATH, FILE_READ);
    
    if (!logFile) {
        return 0;
    }
    
    unsigned long count = 0;
    String line;
    
    while (logFile.available()) {
        line = logFile.readStringUntil('\n');
        line.trim();
        
        // Pomijaj puste linie i komentarze
        if (line.length() > 0 && !line.startsWith("#")) {
            // Sprawdź czy to prawidłowy JSON z naszymi polami
            if (line.indexOf("\"id\":") != -1 && line.indexOf("\"timestamp\":") != -1) {
                count++;
            }
        }
    }
    
    logFile.close();
    return count;
}

/**
 * Pobierz ostatnie N zdarzeń z loga
 */
String getRecentEvents(int count) {
    if (!sdInitialized) {
        return "{\"error\":\"SD not initialized\"}";
    }
    
    File logFile = SD.open(LOG_FILE_PATH, FILE_READ);
    
    if (!logFile) {
        return "{\"error\":\"Cannot open log file\"}";
    }
    
    // Dla uproszczenia - czytaj wszystkie linie i weź ostatnie N
    // W przyszłości można zoptymalizować czytając od końca
    String lines[50];  // Bufor na ostatnie 50 linii
    int lineCount = 0;
    int bufferIndex = 0;
    
    while (logFile.available() && lineCount < 1000) {  // Max 1000 linii skanowania
        String line = logFile.readStringUntil('\n');
        line.trim();
        
        if (line.length() > 0 && !line.startsWith("#")) {
            lines[bufferIndex] = line;
            bufferIndex = (bufferIndex + 1) % 50;  // Circular buffer
            if (lineCount < 50) lineCount++;
        }
    }
    
    logFile.close();
    
    // Utwórz JSON array z ostatnimi zdarzeniami
    JsonDocument responseDoc;
    JsonArray events = responseDoc["events"].to<JsonArray>();
    
    int startIndex = (lineCount == 50) ? bufferIndex : 0;
    int actualCount = min(count, lineCount);
    
    for (int i = 0; i < actualCount; i++) {
        int index = (startIndex + lineCount - actualCount + i) % 50;
        
        JsonDocument eventDoc;
        DeserializationError error = deserializeJson(eventDoc, lines[index]);
        
        if (!error) {
            events.add(eventDoc);
        }
    }
    
    responseDoc["total_events"] = totalLoggedEvents;
    responseDoc["returned_count"] = actualCount;
    
    String result;
    serializeJson(responseDoc, result);
    return result;
}

/**
 * Pobierz informacje o pliku logów
 */
String getLogFileInfo() {
    if (!sdInitialized) {
        return "{\"error\":\"SD not initialized\"}";
    }
    
    JsonDocument infoDoc;
    
    if (SD.exists(LOG_FILE_PATH)) {
        File logFile = SD.open(LOG_FILE_PATH, FILE_READ);
        if (logFile) {
            infoDoc["file_exists"] = true;
            infoDoc["file_size"] = logFile.size();
            infoDoc["total_events"] = totalLoggedEvents;
            logFile.close();
        } else {
            infoDoc["file_exists"] = true;
            infoDoc["error"] = "Cannot open file";
        }
    } else {
        infoDoc["file_exists"] = false;
    }
    
    infoDoc["log_path"] = LOG_FILE_PATH;
    infoDoc["sd_initialized"] = sdInitialized;
    
    String result;
    serializeJson(infoDoc, result);
    return result;
}

/**
 * Wyświetl informacje o karcie SD (Pico2 simplified version)
 */
void displaySDInfo() {
    Serial.println("[SD-LOGGER-INFO] === INFORMACJE O KARCIE SD (PICO2) ===");
    
    if (!sdInitialized) {
        Serial.println("[SD-LOGGER-INFO] Karta SD nie zainicjalizowana");
        return;
    }
    
    // Pico2 SD library ma ograniczone API - sprawdzamy tylko podstawowe info
    Serial.println("[SD-LOGGER-INFO] Karta SD: Dostępna i działająca");
    
    // Test dostępności przez próbę otwarcia pliku
    File testFile = SD.open("/");
    if (testFile) {
        int fileCount = 0;
        while (true) {
            File entry = testFile.openNextFile();
            if (!entry) break;
            fileCount++;
            entry.close();
        }
        testFile.close();
        
        Serial.printf("[SD-LOGGER-INFO] Plików w root: %d\n", fileCount);
    }
    
    // Sprawdź czy nasz plik logów istnieje
    if (SD.exists(LOG_FILE_PATH)) {
        File logFile = SD.open(LOG_FILE_PATH);
        if (logFile) {
            Serial.printf("[SD-LOGGER-INFO] Plik logów: %s (%.2f KB)\n", 
                          LOG_FILE_PATH, logFile.size() / 1024.0);
            logFile.close();
        }
    } else {
        Serial.printf("[SD-LOGGER-INFO] Plik logów: %s (nie istnieje)\n", LOG_FILE_PATH);
    }
    
    Serial.printf("[SD-LOGGER-INFO] Łączna liczba zdarzeń: %lu\n", totalLoggedEvents);
    Serial.println("[SD-LOGGER-INFO] =======================================");
}

/**
 * Sprawdź czy SD karta jest dostępna
 */
bool isSDWorking() {
    if (!sdInitialized) {
        return false;
    }
    
    // Test zapisu - utwórz tymczasowy plik
    File testFile = SD.open("/test.tmp", FILE_WRITE);
    if (!testFile) {
        return false;
    }
    
    testFile.println("test");
    testFile.close();
    
    // Sprawdź czy można odczytać
    testFile = SD.open("/test.tmp", FILE_READ);
    if (!testFile) {
        return false;
    }
    
    String content = testFile.readStringUntil('\n');
    
    testFile.close();
    
    // Usuń plik testowy
    SD.remove("/test.tmp");
    
    return (content.indexOf("test") != -1);
}

/**
 * Pobierz ostatni błąd logowania
 */
String getLastLogError() {
    return lastLogError;
}

/**
 * Debug - wyświetl status SD loggera
 */
void debugSDLogger() {
    Serial.println("[SD-LOGGER-DEBUG] === STATUS SD LOGGER ===");
    Serial.printf("[SD-LOGGER-DEBUG] SD zainicjalizowana: %s\n", sdInitialized ? "TAK" : "NIE");
    Serial.printf("[SD-LOGGER-DEBUG] Łączne zdarzenia: %lu\n", totalLoggedEvents);
    Serial.printf("[SD-LOGGER-DEBUG] Ostatni błąd: %s\n", lastLogError.c_str());
    Serial.printf("[SD-LOGGER-DEBUG] SD działa: %s\n", isSDWorking() ? "TAK" : "NIE");
    
    if (sdInitialized) {
        Serial.printf("[SD-LOGGER-DEBUG] Plik logów istnieje: %s\n", SD.exists(LOG_FILE_PATH) ? "TAK" : "NIE");
    }
    
    Serial.println("[SD-LOGGER-DEBUG] ========================");
    Serial.println();
}